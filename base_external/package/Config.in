## base_external/package/Config.in
```kconfig
config BR2_PACKAGE_AESD_CHAR
	bool "aesd-char"
	depends on BR2_LINUX_KERNEL
	help
	  aesd-char driver - also needs aesd-assignments for demo/test
```

## base_external/package/ldd/Config.in
```kconfig
config BR2_PACKAGE_LDD
    bool "ldd"
    depends on BR2_LINUX_KERNEL
    help
      This package enables support for misc-modules and scull components.
```
